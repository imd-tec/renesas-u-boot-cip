## configs/imdt-v2h-sbc-spl_defconfig
```kconfig
CONFIG_ARM=y
CONFIG_ARCH_CPU_INIT=y
CONFIG_ARCH_RENESAS=y
CONFIG_RCAR_GEN3=y
CONFIG_R9A09G057=y
CONFIG_TARGET_IMDT_RZV2H_EVK=y
CONFIG_DEFAULT_DEVICE_TREE="imdt-v2h-sbc-fastboot"
CONFIG_OF_LIST="imdt-v2h-sbc-fastboot"
CONFIG_OF_UPSTREAM=n
CONFIG_SYS_TEXT_BASE=0x50000000
CONFIG_TEXT_BASE=0x50000000
CONFIG_SYS_LOAD_ADDR=0x58000000
CONFIG_SPL=n
CONFIG_BOARD_LATE_INIT=y
CONFIG_BOARD_SIZE_LIMIT=1572864
CONFIG_SYS_MALLOC_LEN=0x4000000
CONFIG_HUSH_PARSER=y
CONFIG_OF_CONTROL=y
CONFIG_OF_LIBFDT=y
CONFIG_REGMAP=y
CONFIG_SYSCON=y
CONFIG_CLK=y
CONFIG_CLK_RENESAS=y
CONFIG_CLK_R9A09G057=y
CONFIG_DM_GPIO=y
CONFIG_RCAR_GPIO=y
CONFIG_RZV2H_GPIO=y
CONFIG_PINCTRL_PFC_RZV2H=y
CONFIG_DM_REGULATOR=y
CONFIG_DM_REGULATOR_FIXED=y
CONFIG_DM_REGULATOR_GPIO=y
CONFIG_SCIF_CONSOLE=y
CONFIG_CMD_GPIO=y
CONFIG_CMD_MMC=y
CONFIG_CMD_SF=y
CONFIG_CMD_USB=y
CONFIG_CMD_PART=y
CONFIG_PARTITIONS=y
CONFIG_DOS_PARTITION=y
CONFIG_EFI_PARTITION=y
CONFIG_CMD_GPT=y
CONFIG_SH_SDHI=y
CONFIG_MTD=y
CONFIG_DM_MTD=y
CONFIG_SPI=y
CONFIG_DM_SPI=y
CONFIG_RENESAS_RPC_SPI=y
CONFIG_SPI_FLASH=y
CONFIG_DM_SPI_FLASH=y
CONFIG_SPI_FLASH_BAR=y
CONFIG_SPI_FLASH_USE_4K_SECTORS=y
CONFIG_SPI_FLASH_STMICRO=y
CONFIG_SPI_FLASH_WINBOND=y
CONFIG_SPI_FLASH_MACRONIX=y
CONFIG_USB=y
CONFIG_DM_USB=y
CONFIG_USB_OTG=y
CONFIG_USB_GADGET=y
CONFIG_USB_RENESAS_USBHS=y
CONFIG_USB_GADGET_DOWNLOAD=y
CONFIG_USB_GADGET_MANUFACTURER="IMD Technologies"
CONFIG_USB_GADGET_VENDOR_NUM=0x18d1
CONFIG_USB_GADGET_PRODUCT_NUM=0xd00d
CONFIG_USB_FUNCTION_FASTBOOT=y
CONFIG_FASTBOOT_BUF_ADDR=0x62000000
CONFIG_FASTBOOT_BUF_SIZE=0x10000000
CONFIG_FASTBOOT_FLASH=y
CONFIG_FASTBOOT_FLASH_MMC=y
CONFIG_FASTBOOT_FLASH_MMC_DEV=0
CONFIG_FASTBOOT_OEM_RUN=y
CONFIG_ENV_IS_NOWHERE=y
CONFIG_ENV_SOURCE_FILE="imdt-v2h-sbc-fastboot"
CONFIG_ENV_OVERWRITE=y
CONFIG_DM_I2C=y
CONFIG_SYS_I2C_RZG2L_RIIC=y
CONFIG_CMD_I2C=y
CONFIG_EFI_LOADER=n
CONFIG_CMD_NET=n
CONFIG_NET=n
CONFIG_SPL=y
CONFIG_SPL_TEXT_BASE=0x08108000
CONFIG_SPL_SERIAL=n
CONFIG_SPL_YMODEM_SUPPORT=n
CONFIG_SPL_BOARD_INIT=n
CONFIG_DEBUG_UART=n
CONFIG_SPL_SHARES_INIT_SP_ADDR=n
CONFIG_SPL_MAX_SIZE=0x60000
CONFIG_SPL_STACK=0x08180000
CONFIG_SPL_LDSCRIPT="board/imdt/imdt-v2h-sbc/u-boot-spl.lds"
CONFIG_SPL_SEPARATE_BSS=y
CONFIG_SPL_BSS_START_ADDR=0x08150000
CONFIG_SPL_BSS_MAX_SIZE=0x10000
CONFIG_SPL_DM=n
CONFIG_SPL_OF_CONTROL=n
```

## configs/imdt-v2n-sbc-fastboot_defconfig
```kconfig
CONFIG_ARM=y
CONFIG_ARCH_CPU_INIT=y
CONFIG_ARCH_RENESAS=y
CONFIG_RCAR_GEN3=y
CONFIG_R9A09G056=y
CONFIG_TARGET_IMDT_RZV2N_EVK=y
CONFIG_DEFAULT_DEVICE_TREE="imdt-v2n-sbc"
CONFIG_OF_LIST="imdt-v2n-sbc"
CONFIG_OF_UPSTREAM=n
CONFIG_SYS_TEXT_BASE=0x50000000
CONFIG_TEXT_BASE=0x50000000
CONFIG_SYS_LOAD_ADDR=0x58000000
CONFIG_SPL=n
CONFIG_BOARD_SIZE_LIMIT=1572864
CONFIG_SYS_MALLOC_LEN=0x4000000
CONFIG_HUSH_PARSER=y
CONFIG_OF_CONTROL=y
CONFIG_OF_LIBFDT=y
CONFIG_REGMAP=y
CONFIG_SYSCON=y
CONFIG_CLK=y
CONFIG_DM_GPIO=y
CONFIG_RCAR_GPIO=y
CONFIG_RZV2N_GPIO=y
CONFIG_PINCTRL_PFC_RZV2N=y
CONFIG_DM_REGULATOR=y
CONFIG_DM_REGULATOR_FIXED=y
CONFIG_DM_REGULATOR_GPIO=y
CONFIG_SCIF_CONSOLE=y
CONFIG_CMD_GPIO=y
CONFIG_CMD_MMC=y
CONFIG_SUPPORT_EMMC_BOOT=y
CONFIG_CMD_SF=y
CONFIG_CMD_USB=y
CONFIG_CMD_PART=y
CONFIG_PARTITIONS=y
CONFIG_DOS_PARTITION=y
CONFIG_EFI_PARTITION=y
CONFIG_CMD_GPT=y
CONFIG_SH_SDHI=y
CONFIG_MTD=y
CONFIG_DM_MTD=y
CONFIG_SPI=y
CONFIG_DM_SPI=y
CONFIG_RENESAS_RPC_SPI=y
CONFIG_SPI_FLASH=y
CONFIG_DM_SPI_FLASH=y
CONFIG_SPI_FLASH_BAR=y
CONFIG_SPI_FLASH_USE_4K_SECTORS=y
CONFIG_SPI_FLASH_STMICRO=y
CONFIG_SPI_FLASH_WINBOND=y
CONFIG_SPI_FLASH_MACRONIX=y
CONFIG_USB=y
CONFIG_DM_USB=y
CONFIG_USB_OTG=y
CONFIG_USB_GADGET=y
CONFIG_USB_RENESAS_USBHS=y
CONFIG_USB_GADGET_DOWNLOAD=y
CONFIG_USB_GADGET_MANUFACTURER="IMD Technologies"
CONFIG_USB_GADGET_VENDOR_NUM=0x18d1
CONFIG_USB_GADGET_PRODUCT_NUM=0xd00d
CONFIG_USB_FUNCTION_FASTBOOT=y
CONFIG_FASTBOOT_BUF_ADDR=0x62000000
CONFIG_FASTBOOT_BUF_SIZE=0x10000000
CONFIG_FASTBOOT_FLASH=y
CONFIG_FASTBOOT_FLASH_MMC=y
CONFIG_FASTBOOT_FLASH_MMC_DEV=0
CONFIG_FASTBOOT_OEM_RUN=y
CONFIG_ENV_IS_NOWHERE=y
CONFIG_ENV_SOURCE_FILE="imdt-v2n-sbc-fastboot"
CONFIG_ENV_OVERWRITE=y
CONFIG_DM_I2C=y
CONFIG_SYS_I2C_RZG2L_RIIC=y
CONFIG_CMD_I2C=y
CONFIG_EFI_LOADER=n
CONFIG_CMD_NET=n
CONFIG_NET=n
```
