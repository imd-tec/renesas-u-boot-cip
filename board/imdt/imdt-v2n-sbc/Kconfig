## board/imdt/imdt-v2n-sbc/Kconfig
```kconfig
if TARGET_IMDT_RZV2N_EVK

config SYS_SOC
	default "rmobile"

config SYS_BOARD
	default "imdt-v2n-sbc"

config SYS_VENDOR
	default "imdt"

config SYS_CONFIG_NAME
	default "imdt-v2n-sbc"

config RZ_FEATURES_DRPAI
    bool "Enable RZ DRPAI for IMDT V2x SBC"
	default n
    help
      This applied patches included in the meta-rz-drpai layer,
	  to the IMDT V2x SBC.
	  
endif
```

## configs/imdt-v2h-sbc_defconfig
```kconfig
CONFIG_ARM=y
CONFIG_ARCH_CPU_INIT=y
CONFIG_ARCH_RMOBILE=y
CONFIG_SYS_TEXT_BASE=0x50000000
CONFIG_SYS_MEMTEST_START=0x48000000
CONFIG_SYS_MEMTEST_END=0x50000000
CONFIG_ENV_SIZE=0x20000
CONFIG_DM_GPIO=y
CONFIG_DEFAULT_DEVICE_TREE="imdt-v2h-sbc"
CONFIG_RCAR_GEN3=y
CONFIG_R9A09G057=y
CONFIG_TARGET_IMDT_RZV2H_EVK=y
# CONFIG_SPL is not set
CONFIG_FIT=y
CONFIG_SUPPORT_RAW_INITRD=y
CONFIG_DEFAULT_FDT_FILE="imdt-v2h-sbc.dtb"
CONFIG_HUSH_PARSER=y
CONFIG_CMD_BOOTZ=y
CONFIG_CMD_MEMTEST=y
CONFIG_CMD_GPIO=y
CONFIG_CMD_I2C=y
CONFIG_CMD_MMC=y
CONFIG_CMD_PCI=y
CONFIG_CMD_SPI=y
CONFIG_CMD_USB=y
CONFIG_CMD_USB_MASS_STORAGE=y
CONFIG_CMD_DHCP=y
CONFIG_CMD_MII=y
CONFIG_CMD_PING=y
CONFIG_CMD_EXT2=y
CONFIG_CMD_EXT4=y
CONFIG_CMD_EXT4_WRITE=y
CONFIG_CMD_FAT=y
CONFIG_CMD_FS_GENERIC=y
CONFIG_OF_CONTROL=y
CONFIG_ENV_IS_IN_FAT=y
CONFIG_ENV_FAT_DEVICE_AND_PART=":1"
CONFIG_ENV_FAT_FILE="u-boot-env.img"
CONFIG_SYS_MMC_ENV_PART=1
CONFIG_VERSION_VARIABLE=y
CONFIG_REGMAP=y
CONFIG_SYSCON=y
CONFIG_CLK=y
CONFIG_RCAR_GPIO=y
CONFIG_RZV2H_GPIO=y
CONFIG_DM_I2C=y
CONFIG_SYS_I2C_RCAR_IIC=y
CONFIG_SYS_I2C_RZG2L_RIIC=y
CONFIG_SH_SDHI=y
CONFIG_DM_SPI_FLASH=y
CONFIG_SPI_FLASH_STMICRO=y
CONFIG_SPI_FLASH_WINBOND=y
CONFIG_BITBANGMII=y
CONFIG_PHY_MICREL=y
CONFIG_PHY_MICREL_KSZ90X1=y
CONFIG_DM_ETH=y
CONFIG_DM_ETH_PHY=y
CONFIG_DWC_ETH_QOS=y
CONFIG_DWC_ETH_QOS_RZV2H=y
CONFIG_RENESAS_RAVB=y
CONFIG_PCI=y
CONFIG_PCI_RCAR_GEN3=y
CONFIG_PINCTRL_PFC_RZV2H=y
CONFIG_DM_REGULATOR=y
CONFIG_DM_REGULATOR_FIXED=y
CONFIG_DM_REGULATOR_GPIO=y
CONFIG_SCIF_CONSOLE=y
CONFIG_SPI=y
CONFIG_DM_SPI=y
CONFIG_RENESAS_RPC_SPI=y
CONFIG_TEE=y
CONFIG_OPTEE=y
CONFIG_USB=y
CONFIG_USB_XHCI_HCD=y
CONFIG_USB_EHCI_HCD=y
CONFIG_USB_EHCI_GENERIC=y
CONFIG_USB_STORAGE=y
CONFIG_USB_GADGET=y
CONFIG_USB_RENESAS_USBHS=y
CONFIG_USB_GADGET_DOWNLOAD=y
CONFIG_OF_LIBFDT_OVERLAY=y
CONFIG_SPI_FLASH_MACRONIX=y
CONFIG_ADD_OVERLAYS="imdt-v2-sbc-dsi-panel.dtb"
```
